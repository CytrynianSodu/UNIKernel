## drivers/input/touchscreen/GOYA/Kconfig
```kconfig
config TOUCHSCREEN_FT5306
	tristate "FT5306 Touchscreen interface support"
	depends on I2C
	help
	  Say Y here if enable support for the FT5306 touchscreen controller.

config TOUCHSCREEN_GT9XX
	tristate "GT9XX Touchscreen interface support"
	depends on I2C
	help
	  Say Y here if enable support for the Goodix GT9XX multi fingers
	  touchscreen controller.
config TOUCHSCREEN_VNC
       tristate "VNC based touchscreen"
       help
        Say Y here to enable support for VNC virtual touch screen driver
        If unsure, say N.
        If sure, say Y.

config TOUCHSCREEN_SYNAPTICS_I2C_RMI
	tristate "Synaptics i2c touchscreen"
	depends on I2C
	help
	  This enables support for Synaptics RMI over I2C based touchscreens.

config TOUCHSCREEN_SYNAPTICS_DSX_I2C
	tristate "Synaptics DSX I2C touchscreen"
	depends on I2C
	help
	  Say Y here if you have a Synaptics DSX I2C touchscreen
	  connected to your system. If unsure, say N.

	  To compile this driver as a module, choose M here: the
	  module will be called synaptics_dsx_i2c.

config TOUCHSCREEN_MMS136_TS
       tristate "MELFAS MMS-136 touchscreen driver"
       depends on I2C
       default n
-       help
         Say Y here if you have a MELFAS MMS-100 series touchscreen.

         If unsure, say N.

config TOUCHSCREEN_MXT224S
	tristate "Atmel MaxTouch 224S"
	depends on I2C
	default n
	help
	  Say Y here to enable support for the Atmel MaxTouch 224 touch
	  controller.

	  If unsure, say N.

	  To compile this driver as a module, choose M here: the
	  module will be called mxt336S.

config TOUCHSCREEN_BT432_TS
       tristate "ZINITIX BT432 touchscreen driver"
       depends on I2C
       default n
       help
         Say Y here if you have a ZINITIX BT432 touchscreen.

         If unsure, say N.
         
config TOUCHSCREEN_BT531_TS
       tristate "ZINITIX BT531 touchscreen driver"
       depends on I2C
       default n
       help
         Say Y here if you have a ZINITIX BT531 touchscreen.

         If unsure, say N.
	 
config TOUCHSCREEN_BT532_TS
	bool "ZINITIX BT532 touchscreen driver"
	depends on I2C
	default n
	help
	  Say Y here if you have a ZINITIX BT532 touchscreen.

	  If unsure, say N.	  

config TOUCHSCREEN_BT532_TS_ORIENTATION
	int "ZINITIX BT532 touchscreen driver orientation"
	depends on TOUCHSCREEN_BT532_TS
	default "0"
	help
	  ZINITIX BT532 touchscreen driver orientation.
	     0: portrait
	     6: landscape

config TOUCHSCREEN_CYPRESS_TMA46X
	tristate "CYPRESS TMA46X I2C Touchscreen"
	depends on I2C
	help
	  Say Y here if you have Cypress tma46x I2C touchscreen,
	  such as TMA46x, connected to your system.

	  If unsure, say N.

	  To compile this driver as a module, choose M here: the
	  module will be called tma46x.
source "drivers/input/touchscreen/MMS144/Kconfig"
```

## drivers/nfc/pn544/Kconfig
```kconfig
config NFC_PN544
        bool "NXP PN544 NFC Controller Driver"
	default n
        help
          NXP PN544 Near Field Communication controller support.
          This option enables device driver support for the NFC.
          It is used by many services. NFC is fully controlled using I2C
          to communicate the AP chip.

config NFC_PN544_I2C
	tristate "NXP PN544 device support (I2C)"
	depends on NFC_HCI && I2C && NFC_SHDLC
	select NFC_PN544
	---help---
	  This module adds support for the NXP pn544 i2c interface.
	  Select this if your platform is using the i2c bus.

	  If you choose to build a module, it'll be called pn544_i2c.
	  Say N if unsure.

config NFC_PN544_MEI
	tristate "NXP PN544 device support (MEI)"
	depends on NFC_HCI && NFC_MEI_PHY
	select NFC_PN544
	---help---
	  This module adds support for the mei interface of adapters using
	  NXP pn544 chipsets.  Select this if your pn544 chipset
	  is handled by Intel's Management Engine Interface on your platform.

	  If you choose to build a module, it'll be called pn544_mei.
	  Say N if unsure.
```
